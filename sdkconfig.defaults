## sdkconfig.defaults
```kconfig
# esp-matter examples/icd_app の sdkconfig.defaults をベースに、温湿度センサ用に調整

CONFIG_IDF_TARGET="esp32c6"
CONFIG_ESPTOOLPY_FLASHSIZE_4MB=y

# ---- BLE (コミッショニング用) ----
CONFIG_BT_ENABLED=y
CONFIG_BT_NIMBLE_ENABLED=y
CONFIG_BT_NIMBLE_ENABLE_CONN_REATTEMPT=n
CONFIG_BT_LE_SLEEP_ENABLE=y
CONFIG_BT_LE_LP_CLK_SRC_MAIN_XTAL=y

# ---- パーティション ----
CONFIG_PARTITION_TABLE_CUSTOM=y
CONFIG_PARTITION_TABLE_FILENAME="partitions.csv"
CONFIG_PARTITION_TABLE_OFFSET=0xC000

# ---- Wi-Fi は使わない (Thread のみ) ----
CONFIG_ESP_WIFI_SOFTAP_SUPPORT=n
CONFIG_ENABLE_WIFI_AP=n
CONFIG_ENABLE_WIFI_STATION=n

CONFIG_MBEDTLS_HKDF_C=y
CONFIG_MBEDTLS_SSL_PROTO_DTLS=y

# ルートノード + 温度センサ + 湿度センサ
CONFIG_ESP_MATTER_MAX_DYNAMIC_ENDPOINT_COUNT=3

# ---- OpenThread (MTD = スリープ可能なエンドデバイス) ----
CONFIG_OPENTHREAD_ENABLED=y
CONFIG_OPENTHREAD_MTD=y
CONFIG_OPENTHREAD_SRP_CLIENT=y
CONFIG_OPENTHREAD_LOG_LEVEL_DYNAMIC=n
CONFIG_OPENTHREAD_LOG_LEVEL_NOTE=y
CONFIG_OPENTHREAD_CLI=n
CONFIG_IEEE802154_SLEEP_ENABLE=y

# ---- LwIP (Thread用。IPv4無効) ----
CONFIG_LWIP_IPV6_AUTOCONFIG=n
CONFIG_LWIP_IPV6_NUM_ADDRESSES=8
CONFIG_LWIP_MULTICAST_PING=y
CONFIG_LWIP_ND6=n
CONFIG_LWIP_IPV4=n
CONFIG_DISABLE_IPV4=y
CONFIG_USE_MINIMAL_MDNS=n

CONFIG_ENABLE_OTA_REQUESTOR=y

# ---- 電源管理: 自動 Light Sleep ----
CONFIG_RTC_CLK_SRC_EXT_CRYS=n
CONFIG_PM_ENABLE=y
CONFIG_PM_DFS_INIT_AUTO=y
CONFIG_PM_POWER_DOWN_PERIPHERAL_IN_LIGHT_SLEEP=y
CONFIG_ESP_SLEEP_POWER_DOWN_FLASH=y
CONFIG_ESP_PHY_MAC_BB_PD=y
CONFIG_FREERTOS_HZ=1000
CONFIG_FREERTOS_USE_TICKLESS_IDLE=y

# ---- ICD (SED) : 30秒ごとに Active Mode へ復帰 ----
CONFIG_ENABLE_ICD_SERVER=y
# Idle(スリープ)期間 = 測定周期
CONFIG_ICD_IDLE_MODE_INTERVAL_SEC=30
# Active期間(測定・送信)
CONFIG_ICD_ACTIVE_MODE_INTERVAL_MS=1000
CONFIG_ICD_ACTIVE_MODE_THRESHOLD_MS=1000
# Idle中の親ルータへのポーリング間隔。SIT ICD は仕様上15秒が上限
CONFIG_ICD_SLOW_POLL_INTERVAL_MS=15000
CONFIG_ICD_FAST_POLL_INTERVAL_MS=500

# ---- コンソール: XIAO の USB-C (USB Serial/JTAG) ----
CONFIG_ESP_CONSOLE_USB_SERIAL_JTAG=y
# USB接続中は Light Sleep しない。ただしホスト(Windows)がUSBをサスペンドすると
# 未接続と判定されてスリープし、COMポートが消える。ログを見続けたい時は
# sdkconfig.defaults.usb_debug を重ねたデバッグビルドを使う
CONFIG_USJ_NO_AUTO_LS_ON_CONNECTION=y
```

## sdkconfig.defaults.usb_debug
```kconfig
# ==============================================================================
# USBデバッグ用 上書き設定
#
# 使い方 (通常ビルドと混ざらないよう別ディレクトリ・別sdkconfigでビルドする):
#   idf.py -B build.usb_debug -D SDKCONFIG=sdkconfig.usb_debug \
#          -D SDKCONFIG_DEFAULTS="sdkconfig.defaults;sdkconfig.defaults.usb_debug" build
#
# 通常ビルドは自動 Light Sleep が有効で、ホストがUSBをサスペンドするとスリープに入り
# USB Serial/JTAG が切断される(COMポートが消える)。
# デバッグ時は Light Sleep を無効にしてUSB接続とログを維持する。
# ICD(SED) は有効のままなので、30秒周期・LED・Thread の動作確認はできる。
# ==============================================================================

# 自動 Light Sleep を無効化
CONFIG_PM_ENABLE=n
CONFIG_FREERTOS_USE_TICKLESS_IDLE=n
```
